// argon argonfan dtbo
/dts-v1/;
/plugin/;

/ {
	compatible = "brcm,bcm2835";

	fragment@0 {
		target = <&i2c_arm>;
		__overlay__ {
			#address-cells = <1>;
			#size-cells = <0>;
			status = "okay";

        argonfan:   argonfan@1a {
				compatible = "argon,argonfan";
				reg = <0x1a>;
				status = "okay";
			};
		};
   };
//	__overrides__ {
//		addr = <&argonfan>,"reg:0";
//	};
};
