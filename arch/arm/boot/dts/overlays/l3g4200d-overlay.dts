// l3g4200d gyro dtob
/dts-v1/;
/plugin/;

/ {
	compatible = "brcm,bcm2835";

	fragment@0 {
		target = <&i2c_arm>;
		__overlay__ {
			#address-cells = <1>;
			#size-cells = <0>;
			status = "okay";

        stgyro:   stgyro@69 {
				compatible = "st,l3g4200d-gyro";
				reg = <0x69>;
				status = "okay";
			};
		};
   };
//	__overrides__ {
//		addr = <&stgyro>,"reg:0";
//	};
};
